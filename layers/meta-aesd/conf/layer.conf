## layers/meta-aesd/conf/layer.conf
```bitbake
# We have a conf and classes directory, add to BBPATH
BBPATH .= ":${LAYERDIR}"

# We have recipes-* directories, add to BBFILES
BBFILES += "${LAYERDIR}/recipes-*/*/*.bb \
            ${LAYERDIR}/recipes-*/*/*.bbappend"

BBFILE_COLLECTIONS += "aesd"
BBFILE_PATTERN_aesd = "^${LAYERDIR}/"
BBFILE_PRIORITY_aesd = "60"

LAYERDEPENDS_aesd = "core"
LAYERSERIES_COMPAT_aesd = "kirkstone"
```
